## CMakeLists.txt
```
# SPDX-License-Identifier: Apache-2.0

cmake_minimum_required(VERSION 3.20.0)

find_package(Zephyr REQUIRED HINTS $ENV{ZEPHYR_BASE})
project(hello_world)

file(GLOB app_sources src/*)
target_sources(app PRIVATE ${app_sources})
```

## west.yml
```
manifest:

  projects:
    - name: zephyr
      url: https://github.com/zephyrproject-rtos/zephyr
      revision: main
      path: zephyr
      west-commands: scripts/west-commands.yml
      import:
        name-allowlist:
          - cmsis
          - hal_espressif

    - name: module-libjansson
      url: git@github.com:palich2000/jansson.git
      revision: main
      path: modules/lib/jansson2

    - name: module-libmsgpackc
      url: git@github.com:palich2000/msgpackc.git
      revision: main
      path: modules/lib/msgpackc

    - name: module-sample
      url: https://github.com/yashi/module-sample
      revision: main
      path: modules/lib/sample

  self:
    path: main-project
```

## prj.conf
```kconfig
# nothing here
CONFIG_NEWLIB_LIBC=y
CONFIG_MAIN_STACK_SIZE=1200
CONFIG_POSIX_API=y

# Logging
CONFIG_LOG=y
CONFIG_PRINTK=y
#CONFIG_LOG_MODE_IMMEDIATE=y


# Generic networking options
#CONFIG_NETWORKING=y
#CONFIG_NET_UDP=y
#CONFIG_NET_IPV4=y
#CONFIG_NET_IPV6=n
#CONFIG_NET_SOCKETS=y
#CONFIG_NET_SOCKETS_POSIX_NAMES=y
#CONFIG_POSIX_MAX_FDS=6
#CONFIG_NET_CONNECTION_MANAGER=y

# Shell
CONFIG_SHELL=y
CONFIG_SHELL_CMDS=y
#CONFIG_NET_SHELL=y

# Network application options and configuration
#CONFIG_NET_CONFIG_SETTINGS=y
#CONFIG_NET_CONFIG_NEED_IPV6=no
#CONFIG_NET_CONFIG_NEED_IPV4=y


CONFIG_CBPRINTF_FP_SUPPORT=y
CONFIG_EVENTS=y

CONFIG_LIBSAMPLE=y
CONFIG_LIBJANSSON2=y
CONFIG_LIBMSGPACKC=y
```

## src/main.c
```c
/*
 * Copyright (c) 2012-2014 Wind River Systems, Inc.
 *
 * SPDX-License-Identifier: Apache-2.0
 */

#include <zephyr/logging/log.h>
LOG_MODULE_REGISTER(module_app);

#include <zephyr/kernel.h>
#include <zephyr/linker/sections.h>
#include <errno.h>
#include <zephyr/shell/shell.h>
#include <libsample.h>
#include <jansson.h>
#include <msgpack.h>

static struct k_sem quit_lock = {0};

static int cmd_sample_quit(const struct shell *shell,
                          size_t argc, char *argv[])
{
    shell_print(shell,"OK");
    shell_print(shell,"%.2f",(double)3.14159);
    k_sem_give(&quit_lock);
    return 0;
}

SHELL_STATIC_SUBCMD_SET_CREATE(sample_commands,
        SHELL_CMD(quit, NULL,
                  "Quit the sample application\n",
                  cmd_sample_quit),
        SHELL_SUBCMD_SET_END
);

SHELL_CMD_REGISTER(sample, &sample_commands,
                   "Sample application commands", NULL);

#define APP_BANNER "My first MCU program"

//LOG_LEVEL_SET(LOG_LEVEL_INF);

void main(void)
{
    static struct k_event init_event;

    msgpack_sbuffer sbuf = {0};

    printk("Hello libsample %s %s\n", LIBSAMPLE_VERSION, jansson_version_str());
    msgpack_sbuffer_init(&sbuf);
    msgpack_sbuffer_destroy(&sbuf);

    k_event_init(&init_event);
    LOG_INF(APP_BANNER);
    k_malloc(100);
    k_sem_init(&quit_lock, 0, UINT_MAX);
    LOG_INF("Starting! %s", CONFIG_BOARD);
    k_sem_take(&quit_lock, K_FOREVER);
    LOG_INF("Stopping...");
}
```
